// ============================================================================
// audio_engine.cpp — Implementation of the I2S audio engine
// ----------------------------------------------------------------------------
// IMPLEMENTATION DETAILS
//   - Uses the low-level ESP-IDF I2S driver directly (i2s_driver_install /
//     i2s_set_pin / i2s_write) instead of the Arduino I2S wrapper. This
//     gives full control over the number of DMA buffers, their size and
//     bit-clock generation — important because heart-sound DSP is CPU-
//     intensive and any underrun would cause an audible click.
//   - PWM on the MAX98357A SD pins is generated by the ESP32 LEDC peripheral
//     at 5 kHz with 8-bit resolution. 5 kHz is well above the ≈100 Hz cutoff
//     of the RC filter (10 kΩ × 1 µF), so the SD pin sees a ripple-free DC
//     voltage that scales linearly with the PWM duty cycle.
//   - The audio task runs on core 1 at high priority so it is never starved
//     by WiFi or web traffic on core 0.
//   - The audio task feeds every generated sample to the on-device WAV
//     recorder before writing it to I2S, so a recording is exactly the
//     same data that was sent to the speakers.
// ============================================================================
#include "audio_engine.h"
#include <driver/i2s.h>

// ============================================================================
// Per-pathologie spatial weights — welk auscultatiepunt het luidst hoort
// 0=stil, 255=max. Klinisch correcte verdelingen.
//
// Volgorde: { AORTIC, PULMONIC, TRICUSPID, MITRAL }
// ============================================================================
const uint8_t PATHOLOGY_WEIGHTS[NUM_PATHOLOGIES][NUM_MODULES] = {
    // NORMAL: gelijk over alle 4 punten
    { 200, 200, 200, 200 },

    // AORTIC_STENOSIS: luidst op aortic punt, straalt naar carotis
    { 255, 200, 130, 100 },

    // MITRAL_REGURGITATION: luidst op mitral apex, straalt naar oksel
    { 100, 120, 180, 255 },

    // MITRAL_STENOSIS: alleen op mitral apex te horen (lokale rumble)
    {  80,  80, 140, 255 },

    // AORTIC_REGURGITATION: luidst tussen aortic en tricuspid (Erb's point)
    { 230, 220, 255, 180 },

    // S3_GALLOP: luidst op mitral apex (linker ventrikel)
    { 120, 140, 200, 255 },

    // S4_GALLOP: ook luidst op mitral apex
    { 130, 150, 210, 255 },

    // ── Pulmonaire paden ──────────────────────────────────────────────────
    // Adem geluiden zijn normaal luidst dorsaal; onze modules zijn anterieur,
    // dus we verdelen gelijkmatig over alle 4 punten.
    // CRACKLES_FINE
    { 200, 200, 200, 200 },
    // CRACKLES_COARSE
    { 200, 200, 200, 200 },
    // WHEEZE_INSPIRATORY
    { 200, 200, 200, 200 },
    // WHEEZE_EXPIRATORY
    { 200, 200, 200, 200 }
};

AudioEngine::AudioEngine()
    : _running(false), _audio_task(nullptr) {
    for (uint8_t i = 0; i < NUM_AUDIO_MODULES; i++) {
        _module_volume[i] = 180;
    }
}

bool AudioEngine::begin() {
    Serial.println("[AUDIO] I2S initialiseren...");

    // I2S configuratie — komt overeen met jullie speaker_code.ino maar
    // dan op 22050 Hz mono.
    i2s_config_t i2s_config = {};
    i2s_config.mode                 = (i2s_mode_t)(I2S_MODE_MASTER | I2S_MODE_TX);
    i2s_config.sample_rate          = AUDIO_SAMPLE_RATE;
    i2s_config.bits_per_sample      = I2S_BITS_PER_SAMPLE_16BIT;
    i2s_config.channel_format       = I2S_CHANNEL_FMT_ONLY_LEFT;  // mono
    i2s_config.communication_format = I2S_COMM_FORMAT_STAND_I2S;
    i2s_config.intr_alloc_flags     = ESP_INTR_FLAG_LEVEL1;
    i2s_config.dma_buf_count        = 8;
    i2s_config.dma_buf_len          = AUDIO_BLOCK_SIZE;
    i2s_config.use_apll             = false;
    i2s_config.tx_desc_auto_clear   = true;

    i2s_pin_config_t pin_config = {};
    pin_config.bck_io_num   = I2S_BCK_PIN;
    pin_config.ws_io_num    = I2S_WS_PIN;
    pin_config.data_out_num = I2S_DO_PIN;
    pin_config.data_in_num  = I2S_PIN_NO_CHANGE;

    if (i2s_driver_install(I2S_NUM_0, &i2s_config, 0, nullptr) != ESP_OK) {
        Serial.println("[AUDIO] FOUT: I2S installatie mislukt");
        return false;
    }
    if (i2s_set_pin(I2S_NUM_0, &pin_config) != ESP_OK) {
        Serial.println("[AUDIO] FOUT: I2S pinnen toewijzen mislukt");
        return false;
    }

    // PWM-kanalen instellen voor de SD/GAIN pinnen van elke MAX98357
    // (één per fysieke speaker)
    for (uint8_t m = 0; m < NUM_AUDIO_MODULES; m++) {
        // 5 kHz, 8-bit (0..255). RC-filter maakt er een schone DC van.
        ledcSetup(m, 5000, 8);
        ledcAttachPin(MAX98357_GAIN_PINS[m], m);
        ledcWrite(m, _module_volume[m]);
    }

    _recorder.begin();
    Serial.println("[AUDIO] OK");
    return true;
}

void AudioEngine::start() {
    if (_running) return;
    _running = true;
    xTaskCreatePinnedToCore(
        _audioTaskTrampoline,
        "audio_task",
        4096,
        this,
        TASK_PRIO_AUDIO,
        &_audio_task,
        CORE_AUDIO
    );
}

void AudioEngine::stop() {
    _running = false;
    if (_audio_task) {
        vTaskDelay(pdMS_TO_TICKS(20));
        _audio_task = nullptr;
    }
}

void AudioEngine::_audioTaskTrampoline(void* arg) {
    static_cast<AudioEngine*>(arg)->_audioTaskLoop();
    vTaskDelete(nullptr);
}

void AudioEngine::_audioTaskLoop() {
    static int16_t buffer[AUDIO_BLOCK_SIZE];
    size_t bytes_written;

    Serial.printf("[AUDIO] Task gestart op core %d\n", xPortGetCoreID());

    while (_running) {
        _synth.render(buffer, AUDIO_BLOCK_SIZE);

        // Feed to recorder before I2S so capture is synchronous with synthesis
        _recorder.feedSamples(buffer, AUDIO_BLOCK_SIZE);

        i2s_write(I2S_NUM_0, buffer, sizeof(buffer), &bytes_written, portMAX_DELAY);
    }
}

void AudioEngine::setMasterVolume(uint8_t v) {
    _synth.setMasterVolume(v);
}

void AudioEngine::setModuleVolume(uint8_t module, uint8_t vol) {
    if (module >= NUM_AUDIO_MODULES) return;
    _module_volume[module] = vol;
    ledcWrite(module, vol);
}

uint8_t AudioEngine::getModuleVolume(uint8_t module) const {
    return (module < NUM_AUDIO_MODULES) ? _module_volume[module] : 0;
}

// 4-weight (Aortic, Pulmonic, Tricuspid, Mitral) → 2 speakers
// Speaker 0 = upper  = avg(Aortic, Pulmonic)
// Speaker 1 = lower  = avg(Tricuspid, Mitral)
void AudioEngine::setSpatialWeights(const uint8_t weights[NUM_MODULES]) {
    uint8_t upper = (uint8_t)(((uint16_t)weights[POINT_AORTIC]    + weights[POINT_PULMONIC]) / 2);
    uint8_t lower = (uint8_t)(((uint16_t)weights[POINT_TRICUSPID] + weights[POINT_MITRAL])   / 2);
    setModuleVolume(0, upper);
    setModuleVolume(1, lower);
}
